## configs/spacemit_k3_defconfig
```kconfig
CONFIG_RISCV=y
CONFIG_SYS_MALLOC_LEN=0x1000000
CONFIG_SYS_MALLOC_F_LEN=0x80000
CONFIG_NR_DRAM_BANKS=2
CONFIG_HAS_CUSTOM_SYS_INIT_SP_ADDR=y
CONFIG_CUSTOM_SYS_INIT_SP_ADDR=0x102300000
CONFIG_DM_GPIO=y
CONFIG_DEFAULT_DEVICE_TREE="spacemit/k3-pico-itx"
CONFIG_OF_EMBED=y
CONFIG_SYS_BOOTM_LEN=0xa000000
CONFIG_SYS_LOAD_ADDR=0x102000000
CONFIG_DEBUG_UART_BASE=0xd4017000
CONFIG_DEBUG_UART_CLOCK=14700000
CONFIG_TARGET_SPACEMIT_K3=y
CONFIG_ARCH_RV64I=y
CONFIG_CMODEL_MEDANY=y
CONFIG_RISCV_SMODE=y
CONFIG_RISCV_ISA_ZICBOM=y
CONFIG_STACK_SIZE=0x100000
CONFIG_FIT=y
CONFIG_SUPPORT_RAW_INITRD=y
CONFIG_SYS_CBSIZE=256
CONFIG_SYS_PBSIZE=276
# CONFIG_BOARD_INIT is not set
CONFIG_HUSH_PARSER=y
CONFIG_CMD_GPIO=y
CONFIG_CMD_I2C=y
CONFIG_CMD_DHCP=y
CONFIG_CMD_MII=y
CONFIG_CMD_PING=y
CONFIG_CMD_PXE=y
CONFIG_CMD_PMIC=y
CONFIG_CMD_REGULATOR=y
CONFIG_CMD_FAT=y
CONFIG_CMD_FS_GENERIC=y
CONFIG_NET_RANDOM_ETHADDR=y
CONFIG_SYSCON=y
CONFIG_CLK_SPACEMIT=y
CONFIG_CLK_SPACEMIT_K3=y
CONFIG_SPACEMIT_GPIO=y
CONFIG_DM_I2C=y
CONFIG_SYS_I2C_SPACEMIT_K1=y
CONFIG_MISC=y
CONFIG_PHY_GIGE=y
CONFIG_PHY_ANEG_TIMEOUT=500
CONFIG_DWC_ETH_QOS=y
CONFIG_DWC_ETH_QOS_SPACEMIT=y
CONFIG_PHY_REALTEK=y
CONFIG_PHY=y
CONFIG_PINCTRL=y
CONFIG_PINCTRL_SPACEMIT_K1=y
CONFIG_DM_PMIC=y
CONFIG_PMIC_SPACEMIT_P1=y
CONFIG_DM_REGULATOR=y
CONFIG_DM_REGULATOR_FIXED=y
CONFIG_DM_REGULATOR_SPACEMIT_P1=y
CONFIG_DEBUG_UART_NS16550=y
CONFIG_DEBUG_UART_SHIFT=2
CONFIG_DEBUG_UART_ANNOUNCE=y
CONFIG_SYS_NS16550=y
CONFIG_SYS_NS16550_MEM32=y
CONFIG_TIMER_EARLY=y
CONFIG_RESET_SPACEMIT_K3=y
CONFIG_EFI_PARTITION=y
CONFIG_CMD_PART=y
CONFIG_CMD_EXT4=y
CONFIG_PCI=y
CONFIG_PCI_INIT_R=y
CONFIG_CMD_PCI=y
CONFIG_PCIE_DW_SPACEMIT=y
CONFIG_PHY_SPACEMIT_K1_PCIE=y
CONFIG_NVME=y
CONFIG_NVME_PCI=y
CONFIG_CMD_NVME=y
CONFIG_PHYLIB_10G=y
CONFIG_PHY_AQUANTIA=y
CONFIG_PHY_MARVELL_10G=y
CONFIG_RTL8169=y
CONFIG_E1000=y
CONFIG_BNXT_ETH=y
CONFIG_LED=y
CONFIG_LED_BLINK=y
CONFIG_LED_SW_BLINK=y
CONFIG_LED_GPIO=y
CONFIG_LED_LP5562=y
CONFIG_CMD_LED=y
CONFIG_VIDEO=y
CONFIG_VIDEO_SIMPLE=y
CONFIG_VIDEO_DT_SIMPLEFB=y
CONFIG_SYS_WHITE_ON_BLACK=y
CONFIG_DISPLAY=y
CONFIG_I2C_EDID=y
CONFIG_I2C_EDID_STANDARD=y
CONFIG_BMP=y
CONFIG_CMD_BMP=y
CONFIG_USB=y
CONFIG_DM_USB=y
CONFIG_USB_XHCI_HCD=y
CONFIG_USB_XHCI_DWC3=y
CONFIG_USB_DWC3=y
CONFIG_USB_DWC3_GENERIC=y
CONFIG_USB_STORAGE=y
CONFIG_CMD_USB=y
CONFIG_SPI=y
CONFIG_DM_SPI=y
CONFIG_DM_SPI_FLASH=y
CONFIG_FSL_QSPI=y
CONFIG_SPI_FLASH=y
CONFIG_SPI_FLASH_GIGADEVICE=y
CONFIG_SPI_FLASH_MACRONIX=y
CONFIG_SPI_FLASH_WINBOND=y
CONFIG_SPI_FLASH_XMC=y
CONFIG_SPI_FLASH_MTD=y
CONFIG_SPI_MEM=y
CONFIG_MTD=y
CONFIG_DM_MTD=y
CONFIG_MTD_PARTITIONS=y
CONFIG_CMD_SF=y
CONFIG_CMD_MTD=y
CONFIG_MTDIDS_DEFAULT="nor0=d420c000.spi"
CONFIG_MTDPARTS_DEFAULT="d420c000.spi:128K@0(bootinfo),512K@128K(fsbl),64K@640K(env),1M@704K(esos),384K@1728K(opensbi),-@2112K(uboot)"
CONFIG_BOOTDELAY=2
# CONFIG_BOOTSTD_BOOTCOMMAND is not set
CONFIG_USE_BOOTCOMMAND=y
CONFIG_BOOTCOMMAND="pci enum; nvme scan; usb start; if unzip 0x120000000 0x104000000 0x1000000; then mw.l 0x120000000 0 1; fatwrite nvme 0:1 0x104000000 barely-nano.bin ${filesize}; if source 0x11fe00000; then mw.l 0x11fe00000 0 1; else fatwrite nvme 0:1 0x11ff00000 boot.scr 0x2ff; mw.b 0x103F00000 0 0x10000; if load nvme 0:1 0x103F00000 config.toml; then setenv config_addr 0x103F00000; setenv config_size ${filesize}; fi; fi; go 0x104000000; elif load usb 0:1 0x138300000 boot.scr || load nvme 0:1 0x138300000 boot.scr || load mmc 0:1 0x138300000 boot.scr; then source 0x138300000; fi"
# CONFIG_TOOLS_MKEFICAPSULE is not set
```
